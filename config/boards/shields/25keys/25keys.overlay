#include <dt-bindings/zmk/matrix_transform.h>

/ {
    chosen {
        zmk,kscan = &kscan0;
    };

    kscan0: kscan_0 {
        compatible = "zmk,kscan-gpio-matrix";
        diode-direction = "col2row"; // ダイオードはColからRowの向き
        wakeup-source;

        col-gpios
            = <&gpio0 5 GPIO_ACTIVE_HIGH>  // Col0 (例: P0.05)
            // ここにCol1〜Col4のピンを追記！
            ;

        row-gpios
            = <&gpio0 2 (GPIO_ACTIVE_HIGH | GPIO_PULL_DOWN)> // Row0 (例: P0.02)
            // ここにRow1〜Row4のピンを追記！
            ;
    };
};